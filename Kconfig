## Kconfig
```kconfig
menu "ESP Ethernet Component"

    config ETH_PHY_MDC
        int "GPIO pin for PHY MDC signal"
        default 23
        range 0 36
        help 
            GPIO pin for PHY's MDC signal.

    config ETH_PHY_MDIO
        int "GPIO pin for PHY MDIO signal"
        default 18
        range 0 36
        help 
            GPIO pin for PHY's MDIO signal.

    config ETH_PHY_RST_CONNECTED
        bool "Is the PHY's reset connected to the ESP's GPIO?"
        default n
        help
            Is the PHY's reset connected to the ESP's GPIO?

    config ETH_PHY_RST
        int "GPIO pin for PHY's reset signal" if ETH_PHY_RST_CONNECTED
        default -1
        default 0 if ETH_PHY_RST_CONNECTED
        range 0 31 if ETH_PHY_RST_CONNECTED
    
    config ETH_PHY_ADDR_AUTODETECT
        bool "Autodetect the PHY's address"
        default y
        help 
            Autodetect the PHY's address

    config ETH_PHY_ADDR 
        int "PHY's address value" if !ETH_PHY_ADDR_AUTODETECT
        default -1
        default 0 if !ETH_PHY_ADDR_AUTODETECT
        range 0 31 if !ETH_PHY_ADDR_AUTODETECT

    config ETH_DNS_ENABLE
        bool "Enable DNS"
        default y
        help
            Enable DNS
            
    # config ETH_DNS_PRIMARY_IP
    #     string "DNS primary IP address" if ETH_DNS_ENABLE
    #     default "8.8.8.8"
    #     help
    #         DNS primary IP address

    # config ETH_DNS_SECONDARY_IP
    #     string "DNS secondary IP " if ETH_DNS_ENABLE
    #     default "8.8.4.4"
    #     help
    #         DNS secondary IP address

    config ETH_SNTP_ENABLE 
        bool "Enable SNTP" if ETH_DNS_ENABLE
        default y
        help
            Enable SNTP     
endmenu
```
